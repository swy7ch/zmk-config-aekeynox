## config/west.yml
```yaml
manifest:
  remotes:
    - name: zmkfirmware
      url-base: https://github.com/zmkfirmware
    - name: cfergeau
      url-base: https://github.com/cfergeau
    - name: NuclearSquid
      url-base: https://github.com/Nuclear-Squid
  projects:
    - name: zmk
      remote: zmkfirmware
      # Pin ZMK to the tip of the `main` branch on 2026-03-30.
      # https://github.com/Nuclear-Squid/zmk-keyboard-quacken/pull/49#issuecomment-4153385353
      revision: 0331b7d16e80954b807917f9323e59ffc1e3b626
      import: app/west.yml
    - name: zmk-keyboard-quacken
      remote: NuclearSquid
      revision: zmk-main
    - name: zmk-config-totem
      remote: cfergeau
      revision: zmk-module
  self:
    path: config
```
